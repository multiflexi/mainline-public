## Documentation/devicetree/bindings/arm/marvell/armada-8kp.txt
```
Marvell Armada 8K Plus Platforms Device Tree Bindings
-----------------------------------------------------

Armada-8k-plus family will include several SoCs:

Armada-8XXY:    XX - number of cores in the SoC (e.g. 08, 16, 32)
                Y  - number of CP110 in the SoC (e.g. 1, 2, 4)

For example:

 - Armada-8082: will include one AP110 (1 x 8 cores) and 1 CP110
 - Armada-8162: will include two AP110 (2 x 8 cores) and 2 CP110
 - Armada-8328: will include four AP110 (4 x 8 cores) and 8 CP110

Boards using a SoC of the Marvell 8K Plus families must carry
the following root node property:

 - compatible, with one of the following values:

SoC:
   - "marvell,armada8082", "marvell,armada-cp110", "marvell,armada-ap810-octa",
     "marvell,armada-ap810"
      when the SoC being used is the Armada 8082: 8 cores with 2 CP south-bridges

   - "marvell,armada8084", "marvell,armada-cp110", "marvell,armada-ap810-octa",
     "marvell,armada-ap810"
      when the SoC being used is the Armada 8084: 8 cores with 4 CP south-bridges

   - "marvell,armada8162", "marvell,armada-cp110", "marvell,armada-ap810-octa",
     "marvell,armada-ap810"
      when the SoC being used is the Armada 8162: 16 cores with 2 CP south-bridges

   - "marvell,armada8164", "marvell,armada-cp110", "marvell,armada-ap810-octa",
     "marvell,armada-ap810"
      when the SoC being used is the Armada 8164: 16 cores with 4 CP south-bridges

Boards:
   - "marvell,armada-8082-db"
      when the board being used is the Armada-8082 DB board
   - "marvell,armada-8084-db"
      when the board being used is the Armada-8084 DB board
   - "marvell,armada-8162-db"
      when the board being used is the Armada-8162 DB board
   - "marvell,armada-8164-db"
      when the board being used is the Armada-8164 DB board

Example:
compatible = "marvell,armada-8084-db", "marvell,armada-8084",
	     "marvell,armada-ap810-octa", "marvell,armada-ap810";
```
